## arch/mips/oprofile/Kconfig
```kconfig
menu "Profiling support"
	depends on EXPERIMENTAL

config PROFILING
	bool "Profiling support (EXPERIMENTAL)"
	help
	  Say Y here to enable the extended profiling support mechanisms used
	  by profilers such as OProfile.


config OPROFILE
	tristate "OProfile system profiling (EXPERIMENTAL)"
	depends on PROFILING && EXPERIMENTAL
	help
	  OProfile is a profiling system capable of profiling the
	  whole system, include the kernel, kernel modules, libraries,
	  and applications.

	  If unsure, say N.

choice
	prompt "Profiling method"
	default VENUS_OPROFILE_PERFORMANCE_COUNTER
	depends on OPROFILE

config METHOD_TIMER_INTERRUPT
	bool "Use timer interrupt for profiling"
	help
	  No module will be loaded for this.

config VENUS_OPROFILE_PERFORMANCE_COUNTER
	bool "Use performance counter"
	help
	  Use performance counter to profile cache, tlb, branch
	  instructions, ... Mars has this kind of registers, but Venus and
	  Neptune donot.

config VENUS_OPROFILE_CLOCK
	bool "Use Venus CPU clock for oprofile"
	depends on REALTEK_USE_EXTERNAL_TIMER_INTERRUPT
	help
	  Use Venus's CPU clock to drive oprofile, instead of the default
	  scheduler timer interrupt. The CPU clock can drive sampling rate
	  at 2500 (default, changable) per second, compared to 100 sampling
	  per second (fixed) for default timer.


endchoice

config VENUS_OPROFILE_FREQ
	int "Venus oprofile sampling frequency" 
	depends on VENUS_OPROFILE_CLOCK
	default "2500"
	help
	   Sampling frequency of Oprofile using Venus internal clock.

endmenu
```

## drivers/cec/adapter/Kconfig
```kconfig
# drivers/Kconfig

comment"CEC Adapters"
	depends on CEC

config MARS_CEC
	bool "NEPTUNE/MARS/JUPITER CEC Controller"
	depends on CEC && REALTEK_VENUS
	default n
	help
	  If you want to use CEC on Neptune/Mars board, say Y.

config MULTI_PORT_MARS_CEC
	bool "Multi Port CEC Support"
	depends on CEC && REALTEK_VENUS
	select GCEC_RX_EN
	default n
	help
	  If you to use multi port CEC on Neptune/Mars/Jupiter board, say Y.

config GCEC_FIXUP_EN
	bool "GCEC Fixup"
	depends on MARS_CEC && !MULTI_PORT_MARS_CEC
	select KERNEL_GPIO_CONTROL
	default n
	help
	  If you want to use CEC on Neptune/Mars/Jupiter board, say Y.
	  
config GCEC_RX_EN
	bool "GCEC RX"
	depends on MARS_CEC && MULTI_PORT_MARS_CEC
	select KERNEL_GPIO_CONTROL
	default n
	help
	  If you want to use CEC on Neptune/Mars/Jupiter board, say Y.	  
	  
config DEFAULT_GCEC_ISO_GPIO
	bool "USE ISO GPIO"
	depends on GCEC_FIXUP_EN || GCEC_RX_EN
	default n
	help
	  select use ISO GPIO for GCEC FIXUP
	  	  
config DEFAULT_GCEC_GPIO
	int "Default GCEC GPIO Number (255 : determined by boot parameter)"
	depends on GCEC_FIXUP_EN || GCEC_RX_EN
	default "255"
	help
	  GCEC needs to use a free GPIO for CEC Fixup. 
	  You can change it via specify GCEC_GPIO=? in 
	  system_parameter_x boot parameter
```

## drivers/ms/Kconfig
```kconfig
#
# MS subsystem configuration
#

menu "MS/MSPRO Card support"

config MS
	tristate "MS support"
	help
	  MS is the "multi-media card" bus protocol.

	  If you want MS support, you should say Y here and also
	  to the specific driver for your MS interface.

config MS_BLOCK
	tristate "MS block device driver"
	depends on MS
	default y
	help
	  Say Y here to enable the MS block device driver support.
	  This provides a block device driver, which you can use to
	  mount the filesystem. Almost everyone wishing MS support
	  should say Y or M here.

config MS_RTKMS
        tristate "Realtek MS/MSPRO Host Driver"
        depends on MS && MS_BLOCK
        help
          This selects Realtek MS/PRO card reader.

          If unsure, say N.

endmenu
```

## drivers/net/wireless/realtek/Kconfig
```kconfig
menu "Realtek 802.11x wireless LAN devices"	
	depends on NET_RADIO	

source "drivers/net/wireless/realtek/usb/Kconfig"
source "drivers/net/wireless/realtek/pci/Kconfig"

endmenu
```

## drivers/net/wireless/realtek/pci/Kconfig
```kconfig
comment "PCI devices"
       	depends on NET_RADIO && INET && PCI        
       	       
       	       	
config REALTEK_PCI_RTL8185
       	tristate "8185 802.11g chipset support (PCI)"
	depends on NET_RADIO && INET && PCI
	select REALTEK_IEEE80211
	---help---
	  Say Y if you have a PCI 802.11g device with Realtek RTL8185
	  chipset.
       	
config REALTEK_PCI_RTL8190
       	tristate "8190 802.11n chipset support (PCI)"
	depends on NET_RADIO && INET && PCI
	---help---
	  Say Y if you have a PCI 802.11n device with Realtek RTL8190
	  chipset.
	         	
config REALTEK_PCI_RTL8192SE
       	tristate "8192SE 802.11n chipset support (PCI-E)"
       	depends on NET_RADIO && INET && PCI        
       	---help---
         Say Y if you have PCI-E 802.11n devices with Realtek RTL8192SE
         chipset.         

config REALTEK_PCI_RTL8192CE
       	tristate "8192CE/8191CE/8188CE 802.11n chipset support (PCI-E)"
       	depends on NET_RADIO && INET && PCI
       	---help---
         Say Y if you have PCI-E 802.11n devices with Realtek 8192CE series
         chipset.         
```

## drivers/net/wireless/realtek/usb/Kconfig
```kconfig
comment "USB devices"
	depends on NET_RADIO && INET && USB	
	  
config REALTEK_USB_RTL8187
	tristate "8187 802.11g chipset support"
	depends on NET_RADIO && INET && USB
	select REALTEK_IEEE80211
	---help---
	  Say Y if you have a USB 802.11g device with Realtek RTL8187
	  chipset.

config REALTEK_USB_RTL8192
       	tristate "8192 802.11n chipset support"
       	depends on NET_RADIO && INET && USB
       	---help---
         Say Y if you have a USB 802.11n device with Realtek RTL8192
         chipset.

config REALTEK_USB_RTL8191SU
       	tristate "8192SU/8191SU/8188SU/8712SU 802.11n chipset support"
       	depends on NET_RADIO && INET && USB
       	---help---
         Say Y if you have a USB 802.11n device with Realtek RTL8192SU
         chipset.

config REALTEK_USB_RTL8192CU
       	tristate "8192CU/8191CU/8188CU 802.11n chipset support"
       	depends on NET_RADIO && INET && USB
       	---help---
         Say Y if you have a USB 802.11n device with Realtek RTL8192CU
         chipset.

config REALTEK_USB_RTL8192DU
	tristate "8192DU dual band 802.11n chipset support"	
       	depends on NET_RADIO && INET && USB
	---help---
	  Say Y if you have a USB 802.11n device with RTL8192DU
	  chipset.	  
```

## drivers/usb/mtp/Kconfig
```kconfig
config USB_MTP
    tristate "USB MTP/PTP support"
    depends on USB
    ---help---
      Say Y here if you have a USB device that provides MTP/PTP , 
      and you want to connect it to your USB bus.

      To compile this driver as a module, choose M here: the
      module will be called usbmtp.

config USB_MTP_MAX_TRANSFER_SIZE_ENABLE
    bool "Enable USB MTP/PTP Max Transfer Length"
    depends on USB_MTP
    help
      Enable USB MTP/PTP max transfer length support.

      If unsure, say N.
```

## fs/mtpfs/Kconfig
```kconfig
config MTP_FS
	tristate "Mtp File System"
	help
	Most USB based digital camera now adays operate using 
	one of two protocols to talk to the compter. Some use the 
	USB Mass Storage protocol. In general, these are the best 
	supported.When you plug them in, the camera looks just like 
	any other block device and can be treated like a hard drive 
	formatted as fat (or vfat).
	    
	The othe protocol is the "Picture Transfer Protocol. " This
	protocol was developed by the camera manufacturers to allow
	enhanced communication between the camera and the computer.

config MTPFS_FS_READ_AHEAD
    bool "MTPFS Read-Ahead Buffer Support"
    depends on MTP_FS
    help
      Enable MTPFS read-ahead buffer support.

      If unsure, say N.

config MTPFS_DIRECT_IO
    bool "MTPFS Direct I/O Support"
    depends on MTP_FS
    help
      Enable MTPFS direct I/O support.

      If unsure, say N.
```
